## apps/i2c_imu/main/Kconfig.projbuild
```kconfig
menu "QAV250"

    config QAV250_I2C_SDA_GPIO
        int "I2C SDA GPIO"
        range 0 48
        default 40

    config QAV250_I2C_SCL_GPIO
        int "I2C SCL GPIO"
        range 0 48
        default 39

    choice QAV250_MAG_AXES
        prompt "BMM150 axes relative to BMI270"
        default QAV250_MAG_AXES_PHOTO

        config QAV250_MAG_AXES_PHOTO
            bool "Photo breadboard: BMM150 (-X,+Y,-Z) -> BMI270"
            help
                Nominal mounting inferred from the 2026-09-20 photo:
                black BMI270 X points left, purple BMM150 X points right,
                both Y axes point down the photo. Z signs also differ.
                Applies before MEKF initialization and every magnetic update.

        config QAV250_MAG_AXES_ALIGNED
            bool "Identity: BMM150 axes already match BMI270"
    endchoice

    choice QAV250_TELEMETRY_FORMAT
        prompt "Serial telemetry format"
        default QAV250_OUTPUT_RAW_JSON

        config QAV250_OUTPUT_RAW_JSON
            bool "Raw sensor JSON (ax..mz, browser AHRS)"
            help
                Matches the working nine-axis dashboard mode.
                Includes read timestamps and sequence numbers.
                The MEKF still runs but its quaternion is not transmitted.

        config QAV250_OUTPUT_EKF_JSON
            bool "Firmware MEKF JSON (q + sensors)"
            help
                Send the firmware quaternion directly to the dashboard.
                Read docs/QAV250_EKF_review.md for filter limitations.
    endchoice

endmenu
```
